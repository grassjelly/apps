## examples/micrortpsclient/Kconfig
```kconfig
#
# For a description of the syntax of this configuration file,
# see the file kconfig-language.txt in the NuttX tools repository.
#

config EXAMPLES_CLIENT
	bool "Micro RTPS example"
	default n
	depends on MICRORTPS_CLIENT
	---help---
		Enable the Micro RTPS Client example

if EXAMPLES_CLIENT

config EXAMPLES_CLIENT_PROGNAME
	string "Program name"
	default "client"
	depends on BUILD_KERNEL
	---help---
		This is the name of the program that will be use when the NSH ELF
		program is installed.

#config EXAMPLES_CLIENT_PRIORITY
#	int "Client task priority"
#	default 100
#
#config EXAMPLES_CLIENT_STACKSIZE
#	int "Client stack size"
#	default 2048

endif
```

## micrortps/Kconfig
```kconfig
# Kconfig for Micro RTPS

menu "Micro RTPS"

config MICRORTPS_CLIENT
    bool "Enable Micro RTPS Client"
    default n
    ---help---
        Enable support for Micro RTPS Client

if MICRORTPS_CLIENT

comment "Micro RTPS Options"

config MICRORTPS_VERBOSE_OUTPUT
        bool "Enable verbose output"
        default y
        ---help---
            Enable verbose output usefull for debugging.

endif # MICRORTPS_CLIENT

endmenu # Micro RTPS
```
